/*
  Connect to WiFi network generated by ESP32 and tip in your browser:
  AP IPv4: 192.168.4.1
  
  by Vaishak Salin - 2017
  Public Domain
*/

#include <WiFi.h>
#include <aREST.h>
#include <Preferences.h>
#include <DHT.h>
 
#define DHTTYPE DHT11
#define DHTPIN 12
#define AP_SSID  "ESP32_Thing"

//Instantiations
DHT dht(DHTPIN, DHTTYPE, 12);
aREST rest = aREST();
WiFiServer server(80);
Preferences preferences;

//Global Variables
const int LED_PIN = 5;
String wifiSSID;
String wifiPassword;
static volatile bool wifi_connected = false;


// Variables to be exposed to the API
int temperature;
int humidity;

// Declare functions to be exposed to the API
int ledControl(String command);

void WiFiEvent(WiFiEvent_t event)
{
  switch (event) {

    case SYSTEM_EVENT_AP_START:
      //can set ap hostname here
      WiFi.softAPsetHostname(AP_SSID);
      //enable ap ipv6 here
      WiFi.softAPenableIpV6();
      break;
    case SYSTEM_EVENT_STA_START:
      //set sta hostname here
      WiFi.setHostname(AP_SSID);
      break;
    case SYSTEM_EVENT_STA_CONNECTED:
      //enable sta ipv6 here
      WiFi.enableIpV6();
      break;
    case SYSTEM_EVENT_AP_STA_GOT_IP6:
      //both interfaces get the same event
      Serial.print("STA IPv6: ");
      Serial.println(WiFi.localIPv6());
      Serial.print("AP IPv6: ");
      Serial.println(WiFi.softAPIPv6());
      break;
    case SYSTEM_EVENT_STA_GOT_IP:
      wifiOnConnect();
      wifi_connected = true;
      break;
    case SYSTEM_EVENT_STA_DISCONNECTED:
      wifi_connected = false;
      wifiOnDisconnect();
      break;
    default:
      break;
  }
}

String url_decode(String urlEncodedString) 
{
  urlEncodedString.replace("%40", "@");
  return urlEncodedString;
}

void setup()
{
  Serial.begin(115200);
  //Setup pin modes
  pinMode(LED_PIN, OUTPUT);
  
  // Init variables and expose them to REST API
  temperature = 24;
  humidity = 40;
  rest.variable("temperature",&temperature);
  rest.variable("humidity",&humidity);
  // Function to be exposed
  rest.function("led",ledControl);
  // Give name & ID to the device (ID should be 6 characters long)
  rest.set_id("1");
  rest.set_name("esp32");

  //Start WiFi AP
  WiFi.onEvent(WiFiEvent);
  WiFi.mode(WIFI_MODE_APSTA);
  WiFi.softAP(AP_SSID);
  Serial.println("AP Started");
  Serial.print("AP SSID: ");
  Serial.println(AP_SSID);
  Serial.print("AP IPv4: ");
  Serial.println(WiFi.softAPIP());
  //Fetch WiFi SSID and password from non-volatile store
  preferences.begin("wifi", false);
  wifiSSID =  preferences.getString("ssid", "none");
  wifiPassword =  preferences.getString("password", "none");
  preferences.end();
  //URL decode the WiFi configuration
  wifiSSID = url_decode(wifiSSID);
  wifiPassword = url_decode(wifiPassword);
  Serial.print("Stored SSID: ");
  Serial.println(wifiSSID);
  Serial.print("Stored password: ");
  Serial.println(wifiPassword);
  //Start WiFi
  WiFi.begin(wifiSSID.c_str(), wifiPassword.c_str());
  server.begin();
  dht.begin();
}

void loop()
{
  if (wifi_connected) {
    wifiConnectedLoop();
  } else {
    wifiDisconnectedLoop();
  }
}

//when wifi connects
void wifiOnConnect()
{
  Serial.println("STA Connected");
  Serial.print("STA SSID: ");
  Serial.println(WiFi.SSID());
  Serial.print("STA IPv4: ");
  Serial.println(WiFi.localIP());
  Serial.print("STA IPv6: ");
  Serial.println(WiFi.localIPv6());
  WiFi.mode(WIFI_MODE_STA);
}

//when wifi disconnects
void wifiOnDisconnect()
{
  Serial.println("STA Disconnected");
  delay(1000);
  WiFi.begin(wifiSSID.c_str(), wifiPassword.c_str());
}

//while wifi is connected
void wifiConnectedLoop()
{
  humidity = dht.readHumidity();
  temperature = dht.readTemperature(false);
  // Handle REST calls
  WiFiClient client = server.available();
  if (!client) {
    return;
  }
  Serial.println("WiFi Server Available.");
  while(!client.available()){
    delay(1);
  }
  rest.handle(client);
}

void wifiDisconnectedLoop()
{
  // listen for incoming clients
  WiFiClient client = server.available();   

  if (client) {                                 
    Serial.println("New client");           
    String currentLine = "";                
    while (client.connected()) {    
      if (client.available()) {             
        char c = client.read();
        Serial.write(c);                 
        if (c == '\n') {                    
          if (currentLine.length() == 0) {
            // HTTP headers always start with a response code (e.g. HTTP/1.1 200 OK)
            // and a content-type so the client knows what's coming, then a blank line:
            client.println("HTTP/1.1 200 OK");
            client.println("Content-type:text/html");
            client.println();
            // the content of the HTTP response follows the header:
            client.print("<body style='background-color:#49B2E6;font-family:Tahoma,Geneva,sans-serif;color:#fff;'> <style>input{padding: 10px; border: none; border-bottom: solid 2px #c9c9c9; transition: border 0.3s; border-radius: 20px; margin-top: 10px; width: 200px;}input:focus, input.focus{border-bottom: solid 2px #969696;}</style> <form method='get' action='a' style='width: 200px; margin:0 auto;'> <h2 style='text-align:center;font-weight:300;margin-top:50px'>WiFi Login</h2> <input name='ssid' length=32 placeholder='SSID'> <br/> <input name='pass' length=64 placeholder='Password'> <br/> <input type='submit'> </form></body>");
            // The HTTP response ends with another blank line:
            client.println();
            break;
          } else {
            currentLine = "";
          }
        } else if (c != '\r') {
          currentLine += c;
          continue;
        }

        if (currentLine.startsWith("GET /a?ssid=") ) {
          //Expecting something like:
          //GET /a?ssid=blahhhh&pass=poooo
          Serial.println("");
          Serial.println("Cleaning old WiFi credentials from ESP32");
          // Remove all preferences under opened namespace
          preferences.clear();
          String qsid;
          //parse ssid
          qsid = currentLine.substring(12, currentLine.indexOf('&')); 
          Serial.println(qsid);
          Serial.println("");
          String qpass;
          //parse password
          qpass = currentLine.substring(currentLine.lastIndexOf('=') + 1, currentLine.lastIndexOf(' ')); 
          Serial.println(qpass);
          Serial.println("");
          // Note: Namespace name is limited to 15 chars
          preferences.begin("wifi", false); 
          Serial.println("Writing new ssid");
          preferences.putString("ssid", qsid);
          Serial.println("Writing new pass");
          preferences.putString("password", qpass);
          delay(300);
          preferences.end();
          client.println("HTTP/1.1 200 OK");
          client.println("Content-type:text/html");
          client.println();
          // the content of the HTTP response follows the header:
          client.print("<h1>OK! Restarting in 5 seconds...</h1>");
          client.println();
          Serial.println("Restarting in 5 seconds...");
          delay(5000);
          ESP.restart();
        }
      }
    }
    // close the connection:
    client.stop();
    Serial.println("client disconnected");
  }
}

// Custom function accessible by the API
int ledControl(String command) {

  // Get state from command
  int state = command.toInt();

  digitalWrite(LED_PIN,state);
  return 1;
}
